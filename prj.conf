## CMakeLists.txt
```
cmake_minimum_required(VERSION 4.0.3)

include(cmake/BuildOptions.cmake)

if(NOT BUILD_TESTS)
    find_package(Zephyr REQUIRED HINTS $ENV{ZEPHYR_BASE})
endif()

project(env-alert-system)

if(BUILD_TESTS)
    include(CTest)
endif()

# The policy allows us to change options of external projects using set()
# Needed for CppUTest
cmake_policy(SET CMP0077 NEW)
set(CMAKE_POLICY_DEFAULT_CMP0077 NEW)

if(BUILD_TESTS)
    set(PORT "unit-test-off-target")
    add_subdirectory(test)
else()
    set(PORT "nrf52840dk")
endif()

add_subdirectory(src/app)
add_subdirectory(src/port)
add_subdirectory(src/hal)
add_subdirectory(src/utils)
add_subdirectory(src/interfaces)
```

## west.yml
```
manifest:
  remotes:
    - name: nrfconnect
      url-base: https://github.com/nrfconnect
    - name: denis-koshenkov
      url-base: https://github.com/denis-koshenkov

  projects:
    - name: nrf
      remote: nrfconnect
      repo-path: sdk-nrf
      revision: v3.2.3
      import:
        path-prefix: nrf-sdk
    - name: cpputest
      remote: denis-koshenkov
      revision: 8df1f5a4827c0749e3556c99f8c3c24809327bcf # v4.0 + test assert plugin
    - name: sensirion-sht3x
      remote: denis-koshenkov
      revision: v3.0.1
    - name: rohm-bh1750fvi
      remote: denis-koshenkov
      revision: v1.1.0
    - name: ring-buffer
      remote: denis-koshenkov
      revision: v2.0.1
    - name: bosch-bmp280
      remote: denis-koshenkov
      revision: v1.0.2

  self:
    west-commands: scripts/west-commands.yml
```

## prj.conf
```kconfig
CONFIG_SYS_MEM_BLOCKS=y
CONFIG_ASSERT=y
# Main thread prio 0, central event queue thread priority 1
CONFIG_NUM_PREEMPT_PRIORITIES=2
CONFIG_LOG=y
```

## src/alert_condition.c
```c
#include <stddef.h>

#include "alert_condition.h"
#include "eas_assert.h"
#include "config.h"
#include "variable_requirement_evaluator.h"

#ifndef CONFIG_ALERT_CONDITION_MAX_NUM_INSTANCES
#define CONFIG_ALERT_CONDITION_MAX_NUM_INSTANCES 1
#endif

#ifndef CONFIG_ALERT_CONDITION_MAX_NUM_VARIABLE_REQUIREMENTS
#define CONFIG_ALERT_CONDITION_MAX_NUM_VARIABLE_REQUIREMENTS 1
#endif

/**
 * @brief Variable requirements array size.
 *
 * Each AND in the condition is represented as a NULL pointer in the array. The array needs to fit at most
 * CONFIG_ALERT_CONDITION_MAX_NUM_VARIABLE_REQUIREMENTS variable requirements. The worst case scenario in terms of
 * storage is when we have CONFIG_ALERT_CONDITION_MAX_NUM_VARIABLE_REQUIREMENTS requirements, and each of them is
 * separated by an AND - NULL pointer.
 *
 * In that case, we would have (CONFIG_ALERT_CONDITION_MAX_NUM_VARIABLE_REQUIREMENTS - 1) NULL pointers
 * and CONFIG_ALERT_CONDITION_MAX_NUM_VARIABLE_REQUIREMENTS variable requirements. Hence, array size should be
 * (CONFIG_ALERT_CONDITION_MAX_NUM_VARIABLE_REQUIREMENTS + (CONFIG_ALERT_CONDITION_MAX_NUM_VARIABLE_REQUIREMENTS - 1))
 * to always be able to store CONFIG_ALERT_CONDITION_MAX_NUM_VARIABLE_REQUIREMENTS variable requirements.
 */
#define ALERT_CONDITION_VARIABLE_REQUIREMENTS_ARRAY_SIZE                                                               \
    (CONFIG_ALERT_CONDITION_MAX_NUM_VARIABLE_REQUIREMENTS + (CONFIG_ALERT_CONDITION_MAX_NUM_VARIABLE_REQUIREMENTS - 1))

struct AlertConditionStruct {
    VariableRequirement variable_requirements[ALERT_CONDITION_VARIABLE_REQUIREMENTS_ARRAY_SIZE];
    /** Number of variable requirements currently in the alert condition. This excludes the ANDs (NULL pointers), only
     * counts real variable requirements. */
    size_t num_requirements;
    /** Equal to the sum of num_requirements and the number of ANDs (NULL pointers in variable_requirements array).
     * Always equal to the current number of elements in the variable_requirements array. */
    size_t num_items_in_reqs_array;
    bool insert_and_before_next_requirement;
};

static struct AlertConditionStruct instances[CONFIG_ALERT_CONDITION_MAX_NUM_INSTANCES];
static size_t instance_idx = 0;

/**
 * @brief Add a variable requirement to the self->variable_requirements array.
 *
 * @param self Alert condition instance returned by @ref alert_condition_create.
 * @param variable_requirement Variable requirement to add to the list. It is allowed to be NULL - a NULL variable
 * requirement in the array represents a logial AND in the alert condition.
 */
static void add_requirement_to_list(AlertCondition self, VariableRequirement variable_requirement)
{
    EAS_ASSERT(self->num_items_in_reqs_array < ALERT_CONDITION_VARIABLE_REQUIREMENTS_ARRAY_SIZE);
    self->variable_requirements[self->num_items_in_reqs_array++] = variable_requirement;
}

/**
 * @brief Evaluate a ORed variable requirement.
 *
 * @param[in] self Alert condition instance returned by @ref alert_condition_create.
 * @param[in] start_idx Index for the self->variable_requirements array. Should point to the first variable requirement
 * of the ORed variable requirement that needs to be evaluated.
 * @param[out] end_idx This function writes to this parameter the index of the first variable requirement after the one
 * at @p start_idx that is not a part of this ORed requirement. There are two options:
 *   - This ORed variable requirement is not the last one in the alert condition. This means that there is a NULL
 * variable requirement in the array between this ORed variable requirement and the next one. In this case, @p end_idx
 * contains the index of that NULL variable requirement.
 *   - This ORed variable requirement is the last one in the alert condition. In that case, @p end_idx is set to
 * self->num_items_in_reqs_array, because self->num_items_in_reqs_array is the next index after the index of the last
 * variable requirement that is a part of this ORed requirement.
 *
 * @return true The ORed variable requirement evaluated to true.
 * @return false The ORed variable requirement evaluated to false.
 */
static bool evaluate_ored_requirement(AlertCondition self, size_t start_idx, size_t *end_idx)
{
    bool req_result = false;
    size_t req_idx = start_idx;

    /* The ORed requirement ends in two cases: we reached the end of the whole condition, or we reached a logical AND
     * (represented as NULL). */
    while ((req_idx < self->num_items_in_reqs_array) && (self->variable_requirements[req_idx] != NULL)) {
        /* An ORed requirement is a list of variable requirements that are ORed: (req OR req OR req ...). If one of them
         * already evaluated to true, we already know hat the whole ORed condition is true. It is then not necessary to
         * actually evaluate subsequent conditions. We still stay in the loop to reach the end of the ORed condition to
         * set end_idx to the correct value. */
        if (!req_result) {
            req_result = variable_requirement_evaluator_evaluate(self->variable_requirements[req_idx]);
        }
        req_idx++;
    }

    /* This assert fires if the loop body was never entered. This happens if start_idx points to a logical AND or is out
     * of bounds. */
    EAS_ASSERT(req_idx != start_idx);

    *end_idx = req_idx;
    return req_result;
}

AlertCondition alert_condition_create()
{
    EAS_ASSERT(instance_idx < CONFIG_ALERT_CONDITION_MAX_NUM_INSTANCES);
    struct AlertConditionStruct *instance = &instances[instance_idx];
    instance_idx++;

    instance->num_requirements = 0;
    instance->num_items_in_reqs_array = 0;
    instance->insert_and_before_next_requirement = false;
    return instance;
}

void alert_condition_add_variable_requirement(AlertCondition self, VariableRequirement variable_requirement)
{
    bool is_num_allowed_requirements_exceeded =
        (self->num_requirements >= CONFIG_ALERT_CONDITION_MAX_NUM_VARIABLE_REQUIREMENTS);
    EAS_ASSERT(!is_num_allowed_requirements_exceeded);

    if (self->insert_and_before_next_requirement) {
        /* Do not add NULL to the array as the first element - it is already clear that the first element is a start of
         * a new ORed requirement. */
        if (self->num_requirements > 0) {
            /* NULL represents logical AND in the list of requirements */
            add_requirement_to_list(self, NULL);
        }
        self->insert_and_before_next_requirement = false;
    }
    add_requirement_to_list(self, variable_requirement);
    self->num_requirements++;
}

void alert_condition_start_new_ored_requirement(AlertCondition self)
{
    self->insert_and_before_next_requirement = true;
}

bool alert_condition_evaluate(AlertCondition self)
{
    EAS_ASSERT(self->num_items_in_reqs_array > 0);

    bool ored_req_result;
    size_t req_idx = 0;

    while (req_idx < self->num_items_in_reqs_array) {
        ored_req_result = evaluate_ored_requirement(self, req_idx, &req_idx);
        if (!ored_req_result) {
            /* Condition is a list of ORed requirements that are ANDed: (ORed req) AND (ORed req) AND (ORed req) ...
            If one of ORed requirements evaluates to false, we already know that the whole condition is false. */
            return false;
        }

        /* evaluate_ored_requirement set req_idx to the index of the first condition that was not a part of the ORed
         * requirement. Now, req_idx is either pointing at an AND (represented as NULL), or it is equal to
         * self->num_items_in_reqs_array (if it was the last ORed requirement in the condition). We increment req_idx by
         * 1 to skip over the AND (NULL), so that in the next iteration we are pointing to the first requirement of the
         * next ORed requirement. If req_idx is already equal to self->num_items_in_reqs_array, then incrementing it by
         * 1 will not matter - the while loop condition will evaluate to false regardless and we will exit the loop. */
        req_idx++;
    }

    /* All ORed requirements evaluated to true -> condition evaluates to true */
    return true;
}

void alert_condition_for_each(AlertCondition self, AlertConditionForEachCb cb)
{
    EAS_ASSERT(cb);
    for (size_t i = 0; i < self->num_items_in_reqs_array; i++) {
        /* Skip the logical ANDs - represented by NULL pointers */
        if (self->variable_requirements[i] != NULL) {
            cb(self->variable_requirements[i]);
        }
    }
}

void alert_condition_reset(AlertCondition self)
{
    self->num_items_in_reqs_array = 0;
    self->num_requirements = 0;
    self->insert_and_before_next_requirement = false;
}
```

## src/alert_condition.h
~~~~c
#ifndef ALERT_CONDITION_H
#define ALERT_CONDITION_H

#ifdef __cplusplus
extern "C"
{
#endif

#include <stdbool.h>

#include "variable_requirement_defs.h"

/**
 * @brief Alert condition module.
 *
 * The evaluation result of the alert condition is one of the factors that determines whether an alert is considered
 * raised or silenced.
 *
 * An alert condition is a list of variable requirements. These variable requirements can have AND and OR logical
 * operators between them. The evaluation result that is obtained by calling @ref alert_condition_evaluate is the result
 * of evaluating the logical expression that is formed by the variable requirements and the AND and OR logical
 * operators between them.
 *
 * An alert condition is a list of ORed variable requirements separate by AND logical operators. For example:
 * ```
 *   (req_1 OR req_2) AND (req_3 OR req_4)
 * ```
 *
 * A typical usage flow for this module:
 *   -# An alert condition instance is created
 *   -# Variable requirements are added, with signals in between the different ORed conditions. This is done by calling
 * @ref alert_condition_start_new_ored_requirement, as we will see in the below example.
 *   -# The alert condition is evaluated.
 *
 * Here is a code snippet that showcases this usage flow using the example alert condition above:
 * ```
 * // Create alert condition
 * AlertCondition alert_condition = alert_condition_create();
 *
 * // Add all variable requirements
 * alert_condition_add_variable_requirement(alert_condition, req_1);
 * alert_condition_add_variable_requirement(alert_condition, req_2);
 * // Signal the end of the first ORed requirement and the beginning of the next one
 * alert_condition_start_new_ored_requirement(alert_condition);
 * alert_condition_add_variable_requirement(alert_condition, req_3);
 * alert_condition_add_variable_requirement(alert_condition, req_4);
 *
 * // Evaluate the condition
 * bool evaluation_result = alert_condition_evaluate(alert_condition);
 * ```
 *
 * For every AND in the logical expression, @ref alert_condition_start_new_ored_requirement needs to be called. It is
 * also allowed to call @ref alert_condition_start_new_ored_requirement before any variable requirements are added and
 * after all variable requirements have been added to the condition - such calls have no effect on the evaluation
 * result.
 *
 * Note that it is not possible to directly add a condition that has OR operators that take precedence over AND, for
 * example:
 * ```
 *   (req_1 AND req_2) OR (req_3 AND req_4)
 * ```
 *
 * The good news is is that such logical expressions can always be converted to equivalent expressions that have AND
 * operators that take precedence over OR operators. Those expressions can then be directly represetned by this module.
 * Here is an example conversion to a logical expression that can be represented by this module directly:
 * ```
 *   ((req_1 AND req_2) OR (req_3 AND req_4)) <=> ((req_1 AND req_2) OR req_3) AND ((req_1 AND req_2) OR req_4) <=>
 *   (req_1 OR req_3) AND (req_2 OR req_3) AND (req_1 OR req_4) AND (req_2 or req_4)
 * ```
 *
 * @ref alert_condition_for_each can be used when a certain action needs to be performed for every variable requirement
 * in the alert condition.
 *
 * @ref alert_condition_reset can be used to completely reset the alert condition instance to the state as if the
 * instance had just been created. All variable requirements are removed as a result of calling @ref
 * alert_condition_reset.
 */
typedef struct AlertConditionStruct *AlertCondition;

/**
 * @brief Defines callback type to execute for each variable requirement as a part of @ref alert_condition_for_each.
 *
 * @ref alert_condition_for_each executes this callback for each variable requirement present in the alert condition.
 *
 * @param variable_requirement Variable requirement instance for which the callback is being executed.
 */
typedef void (*AlertConditionForEachCb)(VariableRequirement variable_requirement);

/**
 * @brief Create an alert condition instance.
 *
 * @return AlertCondition Created alert condition instance.
 */
AlertCondition alert_condition_create();

/**
 * @brief Add a variable requirement to the alert condition.
 *
 * @param self Alert condition instance returned by @ref alert_condition_create.
 * @param variable_requirement Variable requirement to add to the condition.
 */
void alert_condition_add_variable_requirement(AlertCondition self, VariableRequirement variable_requirement);

/**
 * @brief Singal that the next variable requirement added to the condition should belong to a new ORed requirement.
 *
 * @param self Alert condition instance returned by @ref alert_condition_create.
 */
void alert_condition_start_new_ored_requirement(AlertCondition self);

/**
 * @brief Evaluate the alert condition.
 *
 * @param self Alert condition instance returned by @ref alert_condition_create.
 *
 * @return true Alert condition evaluted to true.
 * @return false Alert condition evaluted to false.
 *
 * @note Fires an assert if the condition contains no variable requirements.
 */
bool alert_condition_evaluate(AlertCondition self);

/**
 * @brief Execute a callback for each variable requirement currently in the alert condition.
 *
 * @param self Alert condition instance returned by @ref alert_condition_create.
 * @param cb Callback to execute for each variable requirement.
 */
void alert_condition_for_each(AlertCondition self, AlertConditionForEachCb cb);

/**
 * @brief Restore the alert condition as if the instance was just created.
 *
 * Removes all variable requirements from the alert condition.
 *
 * @param self Alert condition instance returned by @ref alert_condition_create.
 */
void alert_condition_reset(AlertCondition self);

#ifdef __cplusplus
}
#endif

#endif
~~~~

## src/alert_condition_defs.h
```c
#ifndef ALERT_CONDITION_DEFS_H
#define ALERT_CONDITION_DEFS_H

#ifdef __cplusplus
extern "C"
{
#endif

/**
 * @brief Alert condition public definitions.
 *
 * The definition of the AlertCondition type is here, so that other modules can use it without including the whole
 * alert_condition.h header.
 *
 * For example, the alert conditions module only needs to know about the AlertCondition type definition, it should
 * not know about and expose the whole public API defined in alert_condition.h.
 */

typedef struct AlertConditionStruct *AlertCondition;

#ifdef __cplusplus
}
#endif

#endif
```

## src/alert_conditions.c
```c
#include <stddef.h>

#include "alert_conditions.h"
#include "alert_condition.h"
#include "eas_assert.h"
#include "config.h"

#ifndef CONFIG_MAX_NUM_ALERTS
#define CONFIG_MAX_NUM_ALERTS 1
#endif

static AlertCondition alert_condition_instances[CONFIG_MAX_NUM_ALERTS];

void alert_conditions_create_instances()
{
    for (size_t i = 0; i < CONFIG_MAX_NUM_ALERTS; i++) {
        if (alert_condition_instances[i] != NULL) {
            /* This function has already been called before - instances are already created */
            EAS_ASSERT(0);
        }
    }

    for (size_t i = 0; i < CONFIG_MAX_NUM_ALERTS; i++) {
        alert_condition_instances[i] = alert_condition_create();
    }
}

AlertCondition alert_conditions_get_alert_condition(uint8_t alert_id)
{
    bool is_valid_alert_id = (alert_id < CONFIG_MAX_NUM_ALERTS);
    EAS_ASSERT(is_valid_alert_id);
    AlertCondition alert_condition = alert_condition_instances[alert_id];
    /* This assert will fail if alert_conditions_create_instances has not been called yet. Since
     * the alert_condition_instances array is a static global, it is guaranteed to be initialized to 0.*/
    EAS_ASSERT(alert_condition);

    return alert_condition;
}
```

## src/alert_conditions.h
~~~~c
#ifndef ALERT_CONDITIONS_H
#define ALERT_CONDITIONS_H

#ifdef __cplusplus
extern "C"
{
#endif

#include <stdint.h>

#include "alert_condition_defs.h"

/**
 * @brief Stores alert condition instances for each alert.
 *
 * This module creates and stores CONFIG_MAX_NUM_ALERTS alert condition instances. An instance for an alert with a
 * certain alert id can be retrieved by calling @ref alert_conditions_get_alert_condition.
 *
 * # Usage
 * ```
 * // Create instances - should be called just once
 * alert_conditions_create_instances();
 *
 * // Now that the instances are created, they can be retrieved
 * AlertCondition alert_condition_0 = alert_conditions_get_alert_condition(0);
 * AlertCondition alert_condition_1 = alert_conditions_get_alert_condition(1);
 * ```
 */

/**
 * @brief Creates and stores CONFIG_MAX_NUM_ALERTS alert condition instances.
 *
 * Should be called once before @ref alert_conditions_get_alert_condition is called.
 *
 * @note Fires an assert if called more than once. Instances should only be created once.
 */
void alert_conditions_create_instances();

/**
 * @brief Get alert condition instance for an alert.
 *
 * @param alert_id Alert id of the alert.
 *
 * @return AlertCondition Alert condition instance for the alert with id @p alert_id.
 *
 * @note Fires an assert if alert_id >= CONFIG_MAX_NUM_ALERTS is passed.
 * @note Fires an assert if called before @ref alert_conditions_create_instances.
 */
AlertCondition alert_conditions_get_alert_condition(uint8_t alert_id);

#ifdef __cplusplus
}
#endif

#endif
~~~~

## src/alert_raiser.c
```c
#include <stddef.h>

#include "alert_raiser.h"
#include "alert_notifier.h"
#include "eas_timer.h"
#include "eas_assert.h"
#include "config.h"

#ifndef CONFIG_ALERT_RAISER_MAX_NUM_INSTANCES
#define CONFIG_ALERT_RAISER_MAX_NUM_INSTANCES 1
#endif

struct AlertRaiserStruct {
    EasTimer warmup_timer;
    uint32_t warmup_period_ms;
};

static struct AlertRaiserStruct instances[CONFIG_ALERT_RAISER_MAX_NUM_INSTANCES];
static size_t instance_idx = 0;

static void warmup_period_expired_cb(void *user_data)
{
    alert_notifier_notify(0, true);
}

static void cooldown_period_expired_cb(void *user_data)
{
}

AlertRaiser alert_raiser_create()
{
    EAS_ASSERT(instance_idx < CONFIG_ALERT_RAISER_MAX_NUM_INSTANCES);
    struct AlertRaiserStruct *instance = &instances[instance_idx];
    instance_idx++;

    instance->warmup_timer = eas_timer_create(0, warmup_period_expired_cb, NULL);
    eas_timer_create(0, cooldown_period_expired_cb, NULL);
    instance->warmup_period_ms = 0;

    return instance;
}

void alert_raiser_set_alert(AlertRaiser self, uint8_t alert_id, uint32_t warmup_period_ms, uint32_t cooldown_period_ms)
{
    if (warmup_period_ms > 0) {
        eas_timer_set_period(self->warmup_timer, warmup_period_ms);
    }
    self->warmup_period_ms = warmup_period_ms;
}

void alert_raiser_set_alert_condition_result(AlertRaiser self, bool alert_condition_result)
{
    if (self->warmup_period_ms > 0 && alert_condition_result) {
        eas_timer_start(self->warmup_timer);
    } else {
        alert_notifier_notify(0, alert_condition_result);
    }
}
```

## src/alert_raiser.h
```c
#ifndef ALERT_RAISER_H
#define ALERT_RAISER_H

#ifdef __cplusplus
extern "C"
{
#endif

#include <stdint.h>
#include <stdbool.h>

typedef struct AlertRaiserStruct *AlertRaiser;

AlertRaiser alert_raiser_create();

void alert_raiser_set_alert(AlertRaiser self, uint8_t alert_id, uint32_t warmup_period_ms, uint32_t cooldown_period_ms);

void alert_raiser_set_alert_condition_result(AlertRaiser self, bool alert_condition_result);

#ifdef __cplusplus
}
#endif

#endif
```

## src/current_humidity.h
```c
#ifndef CURRENT_HUMIDITY_H
#define CURRENT_HUMIDITY_H

#ifdef __cplusplus
extern "C"
{
#endif

#include "hal/humidity.h"

/**
 * @brief This module stores current humidity and reports when it changes.
 */

/**
 * @brief Set current humidity value.
 *
 * @param humidity Humidity value to set.
 */
void current_humidity_set(Humidity humidity);

/**
 * @brief Get current humidity value.
 *
 * @pre @ref current_humidity_set has been called at least once.
 *
 * @return humidity Current humidity value.
 */
Humidity current_humidity_get();

/**
 * @brief Check whether the current humidity value has changed.
 *
 * @pre @ref current_humidity_set has been called at least once.
 *
 * @return true The last two calls to @ref current_humidity_set had the same value as arguments, or @ref
 * current_humidity_set has been called only once so far.
 * @return false The last two calls to @ref current_humidity_set had differing values as arguments.
 */
bool current_humidity_is_changed();

#ifdef __cplusplus
}
#endif

#endif
```

## src/current_pressure.c
```c
#include "stdbool.h"

#include "current_pressure.h"
#include "pressure_value.h"

static PressureValue get_instance()
{
    static PressureValue instance;
    static bool is_created = false;
    if (!is_created) {
        instance = pressure_value_create();
        is_created = true;
    }
    return instance;
}

void current_pressure_set(Pressure pressure)
{
    pressure_value_set(get_instance(), pressure);
}

Pressure current_pressure_get()
{
    return pressure_value_get(get_instance());
}

bool current_pressure_is_changed()
{
    return pressure_value_is_value_changed(get_instance());
}
```

## src/current_pressure.h
```c
#ifndef CURRENT_PRESSURE_H
#define CURRENT_PRESSURE_H

#ifdef __cplusplus
extern "C"
{
#endif

#include "hal/pressure.h"

/**
 * @brief This module stores current pressure and reports when it changes.
 */

/**
 * @brief Set current pressure value.
 *
 * @param pressure Pressure value to set.
 */
void current_pressure_set(Pressure pressure);

/**
 * @brief Get current pressure value.
 *
 * @pre @ref current_pressure_set has been called at least once.
 *
 * @return pressure Current pressure value.
 */
Pressure current_pressure_get();

/**
 * @brief Check whether the current pressure value has changed.
 *
 * @pre @ref current_pressure_set has been called at least once.
 *
 * @return true The last two calls to @ref current_pressure_set had the same value as arguments, or @ref
 * current_pressure_set has been called only once so far.
 * @return false The last two calls to @ref current_pressure_set had differing values as arguments.
 */
bool current_pressure_is_changed();

#ifdef __cplusplus
}
#endif

#endif
```

## src/current_temperature.c
```c
#include "stdbool.h"

#include "current_temperature.h"
#include "temperature_value.h"

static TemperatureValue get_instance()
{
    static TemperatureValue instance;
    static bool is_created = false;
    if (!is_created) {
        instance = temperature_value_create();
        is_created = true;
    }
    return instance;
}

void current_temperature_set(Temperature temperature)
{
    temperature_value_set(get_instance(), temperature);
}

Temperature current_temperature_get()
{
    return temperature_value_get(get_instance());
}

bool current_temperature_is_changed()
{
    return temperature_value_is_value_changed(get_instance());
}
```

## src/humidity_requirement.c
```c
#include <stdbool.h>
#include <stdio.h>

#include "variable_requirement_private.h"
#include "humidity_requirement.h"
#include "variable_requirement_allocator.h"

#include "eas_assert.h"
#include "config.h"
#include "utils/util.h"
#include "hal/humidity.h"
#include "current_humidity.h"

typedef struct HumidityRequirementStruct *HumidityRequirement;

struct HumidityRequirementStruct {
    VariableRequirementStruct base;
    Humidity value;
};

EAS_STATIC_ASSERT(sizeof(struct HumidityRequirementStruct) <= CONFIG_VARIABLE_REQUIREMENT_MAX_SIZE);

// Forward declarations of interface functions to define the interface.
static bool evaluate(VariableRequirement base);
static void destroy(VariableRequirement base);

static VariableRequirementInterfaceStruct interface = {
    .evaluate = evaluate,
    .destroy = destroy,
};

/**
 * @brief Evaluate humidity variable requirement.
 *
 * @param base Humidity requirement instance returned by @ref humidity_requirement_create.
 *
 * @return true Humidity requirement is currently satisfied.
 * @return false Humidity requirement is currently not satisfied.
 */
static bool evaluate(VariableRequirement base)
{
    HumidityRequirement self = (HumidityRequirement)base;
    Humidity current_humidity = current_humidity_get();

    bool result;
    switch (self->base.operator) {
    case VARIABLE_REQUIREMENT_OPERATOR_GEQ:
        result = (current_humidity >= self->value);
        break;
    case VARIABLE_REQUIREMENT_OPERATOR_LEQ:
        result = (current_humidity <= self->value);
        break;
    default:
        /* Invalid operator */
        EAS_ASSERT(false);
        return false;
    }

    return result;
}

/**
 * @brief Destroy a humidity variable requirement instance.
 *
 * @param base Humidity requirement instance returned by @ref humidity_requirement_create.
 */
static void destroy(VariableRequirement base)
{
    variable_requirement_allocator_free(base);
}

VariableRequirement humidity_requirement_create(uint8_t alert_id, uint8_t operator, Humidity value)
{
    HumidityRequirement self = variable_requirement_allocator_alloc();
    variable_requirement_create((VariableRequirement)self, &interface, operator, alert_id);

    self->value = value;
    return (VariableRequirement)self;
}
```
